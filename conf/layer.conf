## conf/layer.conf
```bitbake
# We have a conf and classes directory, add to BBPATH
BBPATH .= ":${LAYERDIR}"

# We have recipes-* directories, add to BBFILES
BBFILES += "${LAYERDIR}/recipes-*/*/*.bb \
            ${LAYERDIR}/recipes-*/*/*.bbappend"

BBFILE_COLLECTIONS += "meta-v4l2-m2m-example"
BBFILE_PATTERN_meta-v4l2-m2m-example = "^${LAYERDIR}/"
BBFILE_PRIORITY_meta-v4l2-m2m-example = "6"

LAYERDEPENDS_meta-v4l2-m2m-example = "core"
LAYERSERIES_COMPAT_meta-v4l2-m2m-example = "kirkstone"
```
